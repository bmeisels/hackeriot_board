## software/firmware/hackeriot_board_2025_firmware/boards/hackeriot_board_2025/Kconfig.hackeriot_board_2025
```kconfig
# Copyright (c) 2025 Benny Meisels <benny.meisels@gmail.com>
# SPDX-License-Identifier: Apache-2.0

config BOARD_HACKERIOT_BOARD_2025
	select SOC_STM32G030XX
```

## software/firmware/hackeriot_board_2025_firmware/boards/hackeriot_board_2025/board.yml
```yaml
board:
  name: hackeriot_board_2025
  full_name: Hackeriot Board 2025
  vendor: st
  socs:
    - name: stm32g030xx
```

## software/firmware/hackeriot_board_2025_firmware/boards/hackeriot_board_2025_breadboard/board.yml
```yaml
board:
  name: hackeriot_board_2025_breadboard
  full_name: Hackeriot Board 2025 Breadboard
  vendor: st
  socs:
    - name: stm32g030xx
```

## software/firmware/hackeriot_board_2025_firmware/boards/hackeriot_board_2025_breadboard/hackeriot_board_2025_breadboard_defconfig
```kconfig
# SPDX-License-Identifier: Apache-2.0

# Kernel Options due to Low Memory (8k)
CONFIG_MAIN_STACK_SIZE=640
CONFIG_IDLE_STACK_SIZE=200
CONFIG_ISR_STACK_SIZE=512

# Serial Drivers
CONFIG_SERIAL=y
CONFIG_UART_INTERRUPT_DRIVEN=y
# enable console
CONFIG_CONSOLE=y
CONFIG_UART_CONSOLE=y

# GPIO Controller
CONFIG_GPIO=y

# Buttons driver
CONFIG_INPUT=y
CONFIG_INPUT_GPIO_KEYS=y
CONFIG_INPUT_EVENT_DUMP=y

# HT16k33 driver
CONFIG_LED=y
CONFIG_HT16K33=y

# Randomness for games
CONFIG_TEST_RANDOM_GENERATOR=y
```

## software/firmware/hackeriot_board_zephyr/boards/arm/hackeriot_board/Kconfig.board
```kconfig
# Hackeriot board with STM32G030F6 MCU configuration

# Copyright (c) 2022 Joylab AG <team@joylab.ch>
# SPDX-License-Identifier: Apache-2.0

config BOARD_HACKERIOT_BOARD
	bool "Hackeriot Board"
	depends on SOC_STM32G030XX
```

## software/firmware/hackeriot_board_zephyr/boards/arm/hackeriot_board/Kconfig.defconfig
```kconfig
# STM32 Nucleo-32 development board with STM32G031K8 MCU

# Copyright (c) 2022 Joylab AG <team@joylab.ch>
# SPDX-License-Identifier: Apache-2.0

if BOARD_HACKERIOT_BOARD

config BOARD
	default "hackeriot_board"

config SPI_STM32_INTERRUPT
	default y
	depends on SPI

endif # BOARD_HACKERIOT_BOARD
```
